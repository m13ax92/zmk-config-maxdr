## config/boards/shields/maxdr/Kconfig.defconfig
```kconfig
if SHIELD_MAXDR_LEFT

config ZMK_KEYBOARD_NAME
    default "maxdr"

config ZMK_SPLIT_ROLE_CENTRAL
    default y

endif

if SHIELD_MAXDR_LEFT || SHIELD_MAXDR_RIGHT

config ZMK_SPLIT
    default y

endif
```

## config/boards/shields/maxdr/Kconfig.shield
```kconfig
config SHIELD_MAXDR_LEFT
    def_bool $(shields_list_contains,maxdr_left)

config SHIELD_MAXDR_RIGHT
    def_bool $(shields_list_contains,maxdr_right)
```

## config/west.yml
```yaml
manifest:
  remotes:
    - name: zmkfirmware
      url-base: https://github.com/zmkfirmware
  projects:
    - name: zmk
      remote: zmkfirmware
      # Auf stabiles Release gepinnt (NICHT main): main ist seit der
      # Zephyr-4.1-Migration (Dez 2025) inkompatibel mit dem alten
      # Board-Namen nice_nano_v2. v0.3.0 = letztes Release mit altem Layout.
      revision: v0.3.0
      import: app/west.yml
  self:
    path: config
```
